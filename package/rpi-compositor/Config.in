## package/rpi-compositor/Config.in
```kconfig
config BR2_PACKAGE_RPI_COMPOSITOR
	bool "Compositor for wayland protocol"
	select BR2_PACKAGE_QTBASE
	select BR2_PACKAGE_QTJSBACKEND
	select BR2_PACKAGE_QTSCRIPT
	select BR2_PACKAGE_QTDECLARATIVE
	select BR2_PACKAGE_QTQUICK1
	select BR2_PACKAGE_WAYLAND
	help
		Qt 5 jsbackend module
```

## package/rpi-qmlscene/Config.in
```kconfig
config BR2_PACKAGE_RPI_QMLSCENE
	bool "Qml Scene for Rpi-compositor"
	select BR2_PACKAGE_QTBASE
	select BR2_PACKAGE_RPI_COMPOSITOR
	help
		Qt 5 jsbackend module
```
